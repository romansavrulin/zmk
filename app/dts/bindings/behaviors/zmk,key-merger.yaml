## app/dts/bindings/behaviors/zmk,key-merger.yaml
```yaml
description: |
  Defines a merging rule for a set of key's physical positions

compatible: "zmk,key-merger"

properties:
  map:
    type: array
    required: true
```
